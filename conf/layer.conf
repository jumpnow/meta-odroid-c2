## conf/layer.conf
```bitbake
# We have a conf and classes directory, append to BBPATH
BBPATH .= ":${LAYERDIR}"

BBFILES += "${LAYERDIR}/recipes*/*/*.bb ${LAYERDIR}/recipes*/*/*.bbappend ${LAYERDIR}/images/*.bb"

BBFILE_COLLECTIONS += "meta-odroid-c2"
BBFILE_PATTERN_meta-odroid-c2 := "^${LAYERDIR}/"
BBFILE_PRIORITY_meta-odroid-c2 = "16"

LAYERSERIES_COMPAT_meta-odroid-c2 = "dunfell"
```

## conf/machine/odroid-c2.conf
```bitbake
#@TYPE: Machine
#@NAME: odroid-c2
#@DESCRIPTION: Machine configuration for odroid-c2 systems

SOC_FAMILY = "amlogic:Meson"
require conf/machine/include/soc-family.inc

DEFAULTTUNE = "aarch64"
require conf/machine/include/arm/arch-armv8a.inc

PREFERRED_PROVIDER_virtual/kernel = "linux-stable"
KERNEL_IMAGETYPE = "Image"

PREFERRED_PROVIDER_virtual/bootloader = "u-boot"
PREFERRED_PROVIDER_u-boot = "u-boot"
UBOOT_MACHINE = "odroid-c2_defconfig"
BOOTENV_SIZE = "0x20000"

EXTRA_IMAGEDEPENDS += "u-boot secure-odroid-c2"

SERIAL_CONSOLES = "115200;ttyAML0"

IMAGE_FSTYPES = "tar.xz"

MACHINE_ESSENTIAL_EXTRA_RDEPENDS = "kernel-image kernel-devicetree"

MACHINE_FEATURES = "ext2 serial usbhost vfat"
```
